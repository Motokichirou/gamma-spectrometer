/* pulsegen.c — генератор тестовых импульсов (см. pulsegen.h)
 *
 * Форма: f(t) = (t/tp)² · exp(2·(1 − t/tp)) — гладкий CR-RC²-подобный пик,
 * максимум 1.0 при t = tp. tp = 8 сэмплов (8 мкс @ 1 Мвыб/с), хвост ~40 мкс.
 *
 * Амплитуды: РЕАЛЬНОЕ распределение Cs-137 — inverse-CDF таблица, построенная
 * из спектра «черника в домике.xml» (NaI 40×40 + R1306, 256084 событий;
 * 1024 узла, последний узел = истинный максимум — хвост не обрезается;
 * Ba X-ray 32 кэВ + комптон + фотопик 662 кэВ). Амплитуда = канал/2,
 * гистограмма channel = amplitude×2 восстанавливает исходные каналы.
 */

#include "pulsegen.h"
#include <math.h>

/* Вызывается из ISR TIM7 — держим быстрым независимо от типа сборки */
#pragma GCC optimize ("O2")

#define INVCDF_LEN 1024u

/* inverse CDF амплитуд (ADC/DAC коды), сгенерировано из реального спектра */
static const uint16_t invcdf[INVCDF_LEN] = {
      19,   20,   21,   22,   23,   24,   25,   26,   27,   28,   29,   30,
      31,   32,   33,   33,   34,   35,   36,   37,   38,   38,   39,   40,
      40,   41,   41,   42,   42,   42,   43,   43,   43,   44,   44,   44,
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    1980, 2263, 2662, 4072,
};

static float    shape[PULSEGEN_TABLE_LEN];
static uint32_t mean_period;
static uint16_t baseline;
static uint32_t rng_state = 0xC0FFEE42u;

static volatile pg_mode_t cur_mode = PG_SPECTRUM;
static volatile uint16_t  mono_amp;
static volatile uint32_t  mono_period;

void pulsegen_set_mode(pg_mode_t mode, uint16_t amp, uint32_t period_us)
{
    mono_amp    = amp;
    mono_period = (period_us >= 60u) ? period_us : 60u;
    cur_mode    = mode;
}

pg_mode_t pulsegen_mode(void)
{
    return cur_mode;
}

static uint32_t rng(void)
{
    rng_state = rng_state * 1664525u + 1013904223u;
    return rng_state;
}

/* U(0,1), без нулей (для логарифма) */
static float rng_uf(void)
{
    return ((float)((rng() >> 8) + 1u)) / 16777217.0f;  /* 2^24 */
}

void pulsegen_init(uint32_t mean_period_us, uint16_t dac_baseline)
{
    mean_period = (mean_period_us > 0) ? mean_period_us : 1u;
    baseline    = dac_baseline;

    const float tp = 8.0f;
    for (uint32_t k = 0; k < PULSEGEN_TABLE_LEN; k++) {
        float x = (float)k / tp;
        shape[k] = x * x * expf(2.0f * (1.0f - x));
    }
    shape[PULSEGEN_TABLE_LEN - 1] = 0.0f;
}

static uint16_t next_amplitude(void)
{
    /* выборка из реального распределения: индекс + линейная интерполяция */
    uint32_t r = rng();
    uint32_t idx = (r >> 16) % (INVCDF_LEN - 1u);
    uint32_t frac = r & 0xFFFFu;
    uint32_t a = invcdf[idx];
    uint32_t b = invcdf[idx + 1u];
    return (uint16_t)(a + (((b - a) * frac) >> 16));
}

uint16_t pulsegen_fill(uint32_t *table)
{
    uint16_t amp;
    switch (cur_mode) {
    case PG_SPECTRUM: amp = next_amplitude(); break;
    case PG_MONO:     amp = mono_amp;         break;
    default:          return 0;               /* OFF */
    }
    for (uint32_t k = 0; k < PULSEGEN_TABLE_LEN; k++) {
        uint32_t v = baseline + (uint32_t)(shape[k] * (float)amp + 0.5f);
        table[k] = (v > 4095u) ? 4095u : v;
    }
    return amp;
}

uint32_t pulsegen_next_delay_us(void)
{
    if (cur_mode == PG_MONO)
        return mono_period;          /* фиксированный период: без наложений */
    if (cur_mode == PG_OFF)
        return 1000u;                /* холостой тик */
    float d = -(float)mean_period * logf(rng_uf());
    if (d < 60.0f) d = 60.0f;         /* импульс 48 мкс + возврат к baseline */
    if (d > 60000.0f) d = 60000.0f;
    return (uint32_t)d;
}
